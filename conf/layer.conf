## conf/layer.conf
```bitbake
# We have a conf and classes directory, add to BBPATH
BBPATH .= ":${LAYERDIR}"

# We have a recipes-* directories, add to BBFILES
BBFILES += "${LAYERDIR}/recipes-*/*/*.bb \
	${LAYERDIR}/recipes-*/*/*.bbappend"

BBFILE_COLLECTIONS += "st-lorawan"
BBFILE_PATTERN_st-lorawan = "^${LAYERDIR}/"
BBFILE_PRIORITY_st-lorawan = "7"

EULA_FILE_ST_stm32mplorawan = "${LAYERDIR}/conf/eula/${MACHINE}"
EULA_FILE_ST_MD5SUM_stm32mplorawan = "8b505090fb679839cefbcc784afe8ce9"

# This should only be incremented on significant changes that will
# cause compatibility issues with other layers
LAYERVERSION_st-lorawan = "1"
LAYERSERIES_COMPAT_st-lorawan = "dunfell"

LAYERDEPENDS_lorawan = "core openembedded-layer stm-st-stm32mp"

# OpenSTLinux compatibility version
ST_OSTL_COMPATIBILTY_VERSION_stm-st-stm32mp = "3.1"
 
#SUMMARY = "*** Application DEMO : OpenSTLinux LoRaWAN demo"

IMAGE_INSTALL_append = "    \
mosquitto jq dpkg sudo apt \
redis mosquitto mosquitto-clients \
postgresql postgresql-client postgresql-pltcl \
postgresql-server-dev postgresql-timezone \
postgresql-contrib libecpg \
libecpg-staticdev \
libpq libpq-dev \
libecpg-compat \ 
libpgtypes \
libnewt \
dialog \
nano \
dfu-util \
packagegroup-framework-tools-network \
packagegroup-core-buildessential \
chirpstack-network-server \
chirpstack-gateway-bridge \
chirpstack-application-server \
chirpstack-fuota-server \
dialog \
rak-2245 \
rak-2287 \
rak-5146 \
packet-forwarder \
"
 
```

## conf/machine/stm32mp1-lorawan-m4.conf
```bitbake
#@TYPE: Machine
#@NAME: stm32mp1-lorawan-m4
#@DESCRIPTION: Configuration for STM32CubeMX generated project
#@NEEDED_BSPLAYERS: layers/meta-openembedded/meta-oe layers/meta-openembedded/meta-python

include conf/machine/include/st-machine-common-stm32mp.inc
include conf/machine/include/stm32mp1-mx-extlinux-config.inc
include conf/machine/include/stm32mp1-lorawan-common.inc

# =========================================================================
# CubeMX extra config
# =========================================================================
# Set specific path by components for DT file location
CUBEMX_DTB_PATH_TFA     = "${STM32MP_LORAWAN_BASE}/mx/${CUBEMX_PROJECT}/tf-a"
CUBEMX_DTB_PATH_UBOOT   = "${STM32MP_LORAWAN_BASE}/mx/${CUBEMX_PROJECT}/u-boot"
CUBEMX_DTB_PATH_LINUX   = "${STM32MP_LORAWAN_BASE}/mx/${CUBEMX_PROJECT}/kernel"
CUBEMX_DTB_PATH_OPTEEOS = "${STM32MP_LORAWAN_BASE}/mx/${CUBEMX_PROJECT}/optee-os"

# =========================================================================
# User customizing sections
# =========================================================================

# Boot Scheme
# =========================================================================
# DISCO / EVAL : basic, trusted or optee
# =========================================================================
#BOOTSCHEME_LABELS += "basic"
BOOTSCHEME_LABELS += "trusted"
#BOOTSCHEME_LABELS += "optee"

# Boot Device Choice
# =========================================================================
# DISCO : sdcard
# EVAL  : sdcard, emmc, nand-4-256, nor-sdcard, nor-emmc or nor-nand-4-256
# =========================================================================
# Define the boot device supported
BOOTDEVICE_LABELS += "sdcard"

# WARNING: configs below are only available with EVAL board
#BOOTDEVICE_LABELS += "emmc"
#BOOTDEVICE_LABELS += "nand-4-256"
#BOOTDEVICE_LABELS += "nor-emmc"
#BOOTDEVICE_LABELS += "nor-nand-4-256"
#BOOTDEVICE_LABELS += "nor-sdcard"

# Board Type Choice
# =========================================================================
# DISCO : stm32mp157a-dk1 or stm32mp157c-dk2
# EVAL  : stm32mp157c-ev1
# =========================================================================
# Define the board reference devicetree name
# WARNING: only one setting allowed
#CUBEMX_BOARD_REFERENCE = "stm32mp157a-dk1"
CUBEMX_BOARD_REFERENCE = "stm32mp157c-dk2"
#CUBEMX_BOARD_REFERENCE = "stm32mp157c-ev1"

# CubeMX Project Config
# =========================================================================
# Assign CubeMX Board devicetree and project path name
CUBEMX_DTB = "stm32mp157c-lorawan-m4-mx"
CUBEMX_PROJECT = "STM32MP157C-DK2/lorawan-m4/DeviceTree/lorawan-m4"
#CUBEMX_PROJECT = "STM32MP157C-EV1/DefaultMXConfig/DeviceTree/DefaultMXConfig"
```
